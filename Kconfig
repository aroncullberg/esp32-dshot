## Kconfig
```kconfig
menu "DShot"
    depends on IDF_TARGET_ESP32S3 || IDF_TARGET_ESP32C3

    choice DSHOT_DEFAULT_PROTOCOL
        prompt "Default DShot bitrate"
        default DSHOT_DEFAULT_D600
        config DSHOT_DEFAULT_D150
            bool "DShot150"
        config DSHOT_DEFAULT_D300
            bool "DShot300"
        config DSHOT_DEFAULT_D600
            bool "DShot600"
    endchoice

    config DSHOT_DEFAULT_BITRATE
        int
        default 150000 if DSHOT_DEFAULT_D150
        default 300000 if DSHOT_DEFAULT_D300
        default 600000

    choice DSHOT_DEFAULT_SIGNALING
        prompt "Default signaling"
        default DSHOT_DEFAULT_REGULAR
        help
            Bidirectional mode uses one TX and one RX channel per GPIO and
            receives eRPM/EDT on the signal wire. Requires compatible ESC firmware.
            This backend supports bidirectional D300/D600, initially up to 4 kHz.
        config DSHOT_DEFAULT_REGULAR
            bool "Regular (uninverted)"
        config DSHOT_DEFAULT_BIDIRECTIONAL
            bool "Bidirectional (inverted)"
    endchoice

    config DSHOT_DEFAULT_MOTOR_POLES
        int "Default motor magnetic pole count" if DSHOT_DEFAULT_BIDIRECTIONAL
        range 2 254
        default 14
        help
            Total rotor magnetic poles, not pole pairs or stator teeth. Use an
            even value; the component rejects odd counts during validation.
            Mechanical RPM = electrical RPM / (pole count / 2).
            Set this to your motor's pole count for accurate mechanical RPM.
            This supplies Config::motor_poles; C++ can override the default.
            The default is retained when regular signaling hides this option.

    config DSHOT_DEFAULT_STARTUP_LOW_MS
        int "Default signal-low hold before opening each output (milliseconds)"
        range 0 1000
        default 0
        help
            Set to 300 for AM32 ESCs that remain in their serial bootloader when
            the signal starts high. Each Link::begin() holds the pin low using
            open drain, releases it, then allocates RMT. Zero disables the hold.
            This adds startup time only; it does not change the packet cadence.
            Config::startup_low_ms can override this constructor default.

    config DSHOT_DEFAULT_FRAME_HZ
        int "Default frames per second"
        range 100 8000
        default 1000
        help
            A constructor default, not a promise that every bitrate/signaling
            combination fits. The driver must validate the complete exchange.
            GPTimer wakes the worker independently of the FreeRTOS tick rate.
            The period is rounded to the nearest microsecond; 1000, 2000, 4000,
            and 8000 Hz are exact. Start at 1000 Hz, then measure higher rates.

    config DSHOT_DEFAULT_TASK_PRIORITY
        int "Default worker task priority"
        range 1 20
        default 10

    config DSHOT_DEFAULT_TASK_STACK_BYTES
        int "Default worker task stack size (bytes)"
        range 2048 16384
        default 4096
        help
            ESP-IDF task stack sizes are expressed in bytes.

    config DSHOT_DEFAULT_TASK_CORE
        int "Default worker task core (-1 for no affinity)"
        range -1 0 if FREERTOS_UNICORE
        range -1 1 if !FREERTOS_UNICORE
        default -1
        help
            Task placement only. Interrupt placement follows where channels are
            allocated; this setting does not move an already allocated interrupt.

    config DSHOT_DEFAULT_ERPM_MAX_AGE_US
        int "Default eRPM maximum age (microseconds)"
        range 1000 1000000
        default 10000
        help
            Both moving and stopped samples become stale after this age.

    config DSHOT_DEFAULT_EDT_MAX_AGE_US
        int "Default EDT field maximum age (microseconds)"
        range 1000 10000000
        default 3000000

    config DSHOT_DEFAULT_EDT_VERSION
        int "Default EDT interpretation (1 = legacy, 2 = stress/events)"
        range 1 2
        default 2
        help
            Select the field layout implemented by your ESC firmware. Bluejay's
            enable acknowledgement is 0xE00; it does not identify the layout.
            The raw acknowledgement and all raw status/debug values are retained.

    config DSHOT_DEFAULT_EDT_RESPONSE_TIMEOUT_MS
        int "Default EDT acknowledgement timeout (milliseconds)"
        range 50 5000
        default 300

    config DSHOT_DEFAULT_EDT_ATTEMPTS
        int "Default maximum EDT command attempts"
        range 1 10
        default 3
        help
            Retries only occur while the pending payload remains zero.

    config DSHOT_RMT_RX_IN_IRAM
        bool
        default y
        select RMT_RECV_FUNC_IN_IRAM

    config DSHOT_STAGE_PROFILING
        bool "Compile sampled per-stage profiling"
        depends on FREERTOS_GENERATE_RUN_TIME_STATS && FREERTOS_RUN_TIME_STATS_USING_ESP_TIMER
        default n
        help
            Allow Driver::set_stage_profiling() and the bench4 profile command to
            sample stage elapsed time and core busy time (elapsed minus idle).
            Multicore targets require a pinned worker. Other tasks and interrupt
            attribution can affect busy estimates; this is not an ISR profiler.
            Samples are collected only while requested, independently of the
            older detailed timing diagnostics.

    config DSHOT_STAGE_PROFILE_INTERVAL
        int "Worker updates between stage samples"
        depends on DSHOT_STAGE_PROFILING
        range 1 1024
        default 16
        help
            Sample one worker update in this many updates. Larger values reduce
            measurement overhead. Whole-task/core runtime remains unsampled.

    config DSHOT_TIMING_DIAGNOSTICS
        bool "Compile detailed timing instrumentation"
        default n
        help
            Record elapsed microseconds inside and outside TX waits, worker-pass
            duration, and intervals between observed completions. These timings
            include task preemption; they do not measure CPU usage or GPIO edges.
            Read them through Driver::statistics() or the bench stats command.
            Frame/error and missed-slot counters remain available without this.
endmenu
```

## examples/bench/main/Kconfig.projbuild
```kconfig
menu "DShot bench"
    config DSHOT_BENCH_GPIO
        int "Signal GPIO"
        range -1 21 if IDF_TARGET_ESP32C3
        range -1 48 if IDF_TARGET_ESP32S3
        default -1

    config DSHOT_BENCH_ARM_HOLD_MS
        int "Zero-frame arming time (milliseconds)"
        range 0 30000
        default 5000
endmenu
```

## examples/bench/sdkconfig.defaults
```kconfig
CONFIG_FREERTOS_HZ=1000
CONFIG_DSHOT_DEFAULT_D600=y
CONFIG_DSHOT_DEFAULT_REGULAR=y
CONFIG_DSHOT_DEFAULT_FRAME_HZ=1000
CONFIG_ESP_CONSOLE_UART_DEFAULT=y
CONFIG_ESP_CONSOLE_SECONDARY_NONE=y
```

## examples/bench4/main/Kconfig.projbuild
```kconfig
menu "DShot four-motor bench"
    config DSHOT_BENCH_GPIO
        int "Motor 1 (FL) signal GPIO"
        range 0 48
        default 18

    config DSHOT_BENCH_GPIO_2
        int "Motor 2 (FR) signal GPIO"
        range 0 48
        default 39

    config DSHOT_BENCH_GPIO_3
        int "Motor 3 (RL) signal GPIO"
        range 0 48
        default 38

    config DSHOT_BENCH_GPIO_4
        int "Motor 4 (RR) signal GPIO"
        range 0 48
        default 40

    config DSHOT_BENCH_ARM_HOLD_MS
        int "Zero-frame arming time (milliseconds)"
        range 0 30000
        default 5000
endmenu
```

## examples/bench4/sdkconfig.defaults
```kconfig
CONFIG_IDF_TARGET="esp32s3"
CONFIG_ESP_DEFAULT_CPU_FREQ_MHZ_240=y
CONFIG_COMPILER_OPTIMIZATION_PERF=y
CONFIG_FREERTOS_HZ=1000
CONFIG_FREERTOS_GENERATE_RUN_TIME_STATS=y
CONFIG_FREERTOS_RUN_TIME_STATS_USING_ESP_TIMER=y
CONFIG_FREERTOS_RUN_TIME_COUNTER_TYPE_U64=y
CONFIG_ESP_CONSOLE_USB_SERIAL_JTAG=y
CONFIG_ESP_CONSOLE_SECONDARY_NONE=y
CONFIG_DSHOT_DEFAULT_D600=y
CONFIG_DSHOT_DEFAULT_BIDIRECTIONAL=y
CONFIG_DSHOT_DEFAULT_FRAME_HZ=1000
CONFIG_DSHOT_DEFAULT_TASK_PRIORITY=20
CONFIG_DSHOT_DEFAULT_TASK_CORE=1
CONFIG_DSHOT_STAGE_PROFILING=y
CONFIG_DSHOT_STAGE_PROFILE_INTERVAL=16
CONFIG_DSHOT_DEFAULT_STARTUP_LOW_MS=300
```
